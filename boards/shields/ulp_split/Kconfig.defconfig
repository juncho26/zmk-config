## boards/shields/ulp_split/Kconfig.defconfig
```kconfig
if SHIELD_ULP_SPLIT_LEFT

config ZMK_KEYBOARD_NAME
    default "ULP_Split"

config ZMK_SPLIT_ROLE_CENTRAL
    default y

endif # SHIELD_ULP_SPLIT_LEFT

if SHIELD_ULP_SPLIT_LEFT || SHIELD_ULP_SPLIT_RIGHT

config ZMK_SPLIT
    default y

endif # SHIELD_ULP_SPLIT_LEFT || SHIELD_ULP_SPLIT_RIGHT
```

## boards/shields/ulp_split/Kconfig.shield
```kconfig
config SHIELD_ULP_SPLIT_LEFT
    def_bool $(shields_list_contains,ulp_split_left)

config SHIELD_ULP_SPLIT_RIGHT
    def_bool $(shields_list_contains,ulp_split_right)
```
